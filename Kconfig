## Kconfig
```kconfig
mainmenu "SC OBC Quality Quality Inspection"

config NUM_IRQS
	default 10

config AUTO_RUN
	bool "Run specified test after boot"
	default n
	help
	  With this option, Zephyr will run specified test repeatedly
	  after boot.

config AUTO_RUN_TEST_NUMBER
	int "Specify a test number for auto run"
	default 1
	depends on AUTO_RUN
	help
	  Specify a test number to run.

menu "Zephyr"

source "Kconfig.zephyr"

endmenu
```

## west.yml
```yaml
manifest:

  projects:
    - name: zephyr
      url: https://github.com/zephyrproject-rtos/zephyr
      revision: 7c8264277a9377cd41f8dfe3a777bb897015b562
      path: zephyr
      west-commands: scripts/west-commands.yml
      import:
        name-allowlist:
          - cmsis

  self:
    path: scobca1-fpga-test 
```
